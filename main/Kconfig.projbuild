## main/Kconfig.projbuild
```kconfig
menu "Example Configuration"

    choice EXAMPLE_RGB_PANEL_CONTROLLER
        prompt "RGB PANEL driver IC"
        default EXAMPLE_LCD_CONTROLLER_NV3052C
        help
            Select RGB PANEL driver IC
        
        config EXAMPLE_LCD_CONTROLLER_NV3052C
            bool "nv3052c"
        config EXAMPLE_LCD_H030A10
            bool "H030A10"
        config EXAMPLE_LCD_H035A17
            bool "H035A17"    
        config EXAMPLE_LCD_H040A18
            bool "H040A18"

    endchoice

    config EXAMPLE_LCD_USE_TOUCH_ENABLED
        bool "LCD USE TOUCH PANEL"
        default n
endmenu
```
